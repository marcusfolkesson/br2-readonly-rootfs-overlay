## configs/readonly-rootfs-overlay_defconfig
```kconfig
# Architecture
BR2_x86_64=y

# System
BR2_SYSTEM_DHCP="eth0"

# Filesystem
BR2_TARGET_ROOTFS_EXT2=y
# BR2_TARGET_ROOTFS_TAR is not set

# Image
BR2_ROOTFS_POST_BUILD_SCRIPT="$(BR2_EXTERNAL_READONLY_ROOTFS_OVERLAY_PATH)/board/qemu-x86_64/post-build.sh"

# Image
BR2_ROOTFS_POST_IMAGE_SCRIPT="$(BR2_EXTERNAL_READONLY_ROOTFS_OVERLAY_PATH)/board/qemu-x86_64/post-image.sh"
BR2_ROOTFS_POST_SCRIPT_ARGS="$(BR2_DEFCONFIG)"

# Linux headers same as kernel
BR2_PACKAGE_HOST_LINUX_HEADERS_CUSTOM_6_1=y

# Kernel
BR2_LINUX_KERNEL=y
BR2_LINUX_KERNEL_CUSTOM_VERSION=y
BR2_LINUX_KERNEL_CUSTOM_VERSION_VALUE="6.1.44"
BR2_LINUX_KERNEL_USE_CUSTOM_CONFIG=y
BR2_LINUX_KERNEL_CUSTOM_CONFIG_FILE="$(BR2_EXTERNAL_READONLY_ROOTFS_OVERLAY_PATH)/board/qemu-x86_64/linux.config"
BR2_LINUX_KERNEL_CONFIG_FRAGMENT_FILES="$(BR2_EXTERNAL_READONLY_ROOTFS_OVERLAY_PATH)/board/qemu-x86_64/linux.fragment"
BR2_LINUX_KERNEL_NEEDS_HOST_LIBELF=y

# Support for dracut
BR2_TARGET_ROOTFS_CPIO_DRACUT=y
BR2_TARGET_ROOTFS_CPIO_DRACUT_MODULES="$(BR2_EXTERNAL_READONLY_ROOTFS_OVERLAY_PATH)/dracut/modules.d"
BR2_TARGET_ROOTFS_CPIO_DRACUT_CONF_FILES="$(BR2_EXTERNAL_READONLY_ROOTFS_OVERLAY_PATH)/dracut/conf/dracut.conf"
BR2_TARGET_ROOTFS_INITRAMFS=y
```
